## net/switchdev/Kconfig
```kconfig
#
# Configuration for Switch device support
#

config NET_SWITCHDEV
	boolean "Switch (and switch-ish) device support (EXPERIMENTAL)"
	depends on INET
	---help---
	  This module provides glue between core networking code and device
	  drivers in order to support hardware switch chips in very generic
	  meaning of the word "switch". This include devices supporting L2/L3 but
	  also various flow offloading chips, including switches embedded into
	  SR-IOV NICs.

config NET_SWITCHDEV_NETLINK
	tristate "Netlink interface to Switch device"
	depends on NET_SWITCHDEV
	default m
	---help---
	  This module provides Generic Netlink intercace to hardware switch
	  chips.

	  To compile this code as a module, choose M here: the
	  module will be called switchdev_netlink.
```
